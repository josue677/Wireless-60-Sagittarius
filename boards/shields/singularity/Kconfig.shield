## boards/shields/singularity/Kconfig.shield
```kconfig
config SHIELD_SINGULARITY_LEFT
    def_bool $(shields_list_contains,singularity_left)

config SHIELD_SINGULARITY_RIGHT
    def_bool $(shields_list_contains,singularity_right)
```

## config/boards/shields/Singularity/kconfig.defconfig
```kconfig
if SHIELD_SINGULARITY_LEFT

config ZMK_KEYBOARD_NAME
    default "Singularity_L"

config ZMK_SPLIT_ROLE_CENTRAL
    default y

endif

if SHIELD_SINGULARITY_LEFT || SHIELD_SINGULARITY_RIGHT

config ZMK_SPLIT
    default y

endif
```

## config/boards/shields/Singularity/kconfig.shield
```kconfig
config SHIELD_SINGULARITY_LEFT
    def_bool $(shield_list_contain,corne_left)

config SHIELD_SINGULARITY_RIGHT
    def_bool $(shield_list_contain,corne_right)
```

## config/boards/shields/Singularity_left/kconfig.shield
```kconfig
config SHIELD_SINGULARITY_LEFT
    def_bool $(shield_list_contain,Singularity_left)

config SHIELD_SINGULARITY_RIGHT
    def_bool $(shield_list_contain,Singularity_left)
```

## config/boards/shields/singularity/kconfig.shield
```kconfig
config SHIELD_SINGULARITY_LEFT
    def_bool $(shield_list_contain,Singularity_L)

config SHIELD_SINGULARITY_RIGHT
    def_bool $(shield_list_contain,Singularity_R)
```
