#include "singularity.overlay" // Notice that the main dtsi files are included in the overlay.

&kscan0 {
    col-gpios
        = <&gpio1 11 GPIO_ACTIVE_HIGH> // col7 in the schematic // D14
        , <&gpio0 10 GPIO_ACTIVE_HIGH> // col6 in the schematic // D16
        , <&gpio0 9 GPIO_ACTIVE_HIGH> // col5 in the schematic  // D10
        , <&gpio1 6 GPIO_ACTIVE_HIGH> // col4 in the schematic  // D9
        , <&gpio1 4 GPIO_ACTIVE_HIGH> // col3 in the schematic  // D8
        , <&gpio0 11 GPIO_ACTIVE_HIGH> // col2 in the schematic // D7
        , <&gpio1 0 GPIO_ACTIVE_HIGH> // col1 in the schematic  // D6
        ;
};
