#include "singularity.overlay"

&default_transform { // The matrix transform for this board is 7 columns over because the left half is 7 columns wide.
    col-offset = <7>;
};

&kscan0 {

    compatible = "zmk,kscan-gpio-matrix";
    diode-direction = "col2row";
    row-gpios
        = <&gpio1 15 (GPIO_ACTIVE_HIGH | GPIO_PULL_DOWN)> // Row A from the schematic file D18
        , <&gpio0 2 (GPIO_ACTIVE_HIGH | GPIO_PULL_DOWN)> // Row B from the schematic file  D19
        , <&gpio0 29 (GPIO_ACTIVE_HIGH | GPIO_PULL_DOWN)> // Row C from the schematic file D20
        , <&gpio0 31 (GPIO_ACTIVE_HIGH | GPIO_PULL_DOWN)> // Row D from the schematic file D21
        ;

    col-gpios
        = <&gpio1 11 GPIO_ACTIVE_HIGH> // col6 in the schematic D14
        , <&gpio0 10 GPIO_ACTIVE_HIGH> // col5 in the schematic D16
        , <&gpio0 9 GPIO_ACTIVE_HIGH> // col4 in the schematic  D10
        , <&gpio1 6 GPIO_ACTIVE_HIGH> // col3 in the schematic  D9
        , <&gpio1 4 GPIO_ACTIVE_HIGH>  // col2 in the schematic D8
        , <&gpio0 11 GPIO_ACTIVE_HIGH> // col1 in the schematic D7
        , <&gpio1 0 GPIO_ACTIVE_HIGH>  // col1 in the schematic D6
        , <&gpio0 24 GPIO_ACTIVE_HIGH> // col1 in the schematic D5
        ;
};
